## buildroot-external/configs/rock5b-jesikat_defconfig
```kconfig
BR2_aarch64=y
BR2_cortex_a76_a55=y
BR2_PACKAGE_HOST_LINUX_HEADERS_CUSTOM_7_0=y
#BR2_GLOBAL_PATCH_DIR="board/radxa/rock5b/patches"
BR2_DOWNLOAD_FORCE_CHECK_HASHES=n
BR2_TARGET_GENERIC_HOSTNAME="homeassistant"
BR2_TARGET_GENERIC_ISSUE="Welcome to Rock 5B Home Assistant OS"
BR2_ROOTFS_DEVICE_CREATION_DYNAMIC_MDEV=y
BR2_SYSTEM_DHCP="eth0"
BR2_ROOTFS_POST_BUILD_SCRIPT="board/radxa/rock5b/post-build.sh"
BR2_ROOTFS_POST_IMAGE_SCRIPT="support/scripts/genimage.sh"
BR2_ROOTFS_POST_SCRIPT_ARGS="-c board/radxa/rock5b/genimage.cfg"
BR2_LINUX_KERNEL=y

BR2_LINUX_KERNEL_CUSTOM_TARBALL_LOCATION="https://gitlab.collabora.com/hardware-enablement/rockchip-rk3588/linux/-/archive/rockchip-v7.0/linux-rockchip-v7.0.tar.gz"
## new
BR2_LINUX_KERNEL_CUSTOM_TARBALL=y
BR2_LINUX_KERNEL_CUSTOM_VERSION=y
BR2_LINUX_KERNEL_CUSTOM_VERSION_VALUE="7.0"
BR2_KERNEL_HEADERS_7_0=y
BR2_PACKAGE_HOST_LINUX_HEADERS_CUSTOM_7_0=y
## end
BR2_LINUX_KERNEL_USE_ARCH_DEFAULT_CONFIG=y
### rock5b + haos fragments
BR2_LINUX_KERNEL_CONFIG_FRAGMENT_FILES="board/radxa/rock5b/linux.fragment $(BR2_EXTERNAL_HAOS_PATH)/kernel/v6.18.y/haos.config $(BR2_EXTERNAL_HAOS_PATH)/kernel/v6.18.y/docker.config $(BR2_EXTERNAL_HAOS_PATH)/kernel/v6.18.y/device-support.config"
BR2_LINUX_KERNEL_DTS_SUPPORT=y
BR2_LINUX_KERNEL_INTREE_DTS_NAME="rockchip/rk3588-rock-5b"
BR2_LINUX_KERNEL_INTREE_DTSO_NAMES="rockchip/rk3588-rock-5b-pcie-srns rockchip/rk3588-rock-5b-pcie-ep"
BR2_LINUX_KERNEL_DTB_OVERLAY_SUPPORT=y
BR2_LINUX_KERNEL_INSTALL_TARGET=y
BR2_LINUX_KERNEL_NEEDS_HOST_OPENSSL=y
BR2_LINUX_KERNEL_NEEDS_HOST_PYTHON3=y
BR2_PACKAGE_LINUX_FIRMWARE=y
BR2_PACKAGE_LINUX_FIRMWARE_RTL_8169=y
BR2_TARGET_UBOOT_NEEDS_ATF_BL31=y
BR2_TARGET_UBOOT_NEEDS_ATF_BL31_ELF=y
BR2_PACKAGE_ROCKCHIP_RKBIN=y
BR2_PACKAGE_ROCKCHIP_RKBIN_TPL_FILENAME="bin/rk35/rk3588_ddr_lp4_2112MHz_lp5_2400MHz_v1.18.bin"
BR2_TARGET_ARM_TRUSTED_FIRMWARE=y
BR2_TARGET_ARM_TRUSTED_FIRMWARE_CUSTOM_VERSION=y
BR2_TARGET_ARM_TRUSTED_FIRMWARE_CUSTOM_VERSION_VALUE="v2.12"
BR2_TARGET_ARM_TRUSTED_FIRMWARE_PLATFORM="rk3588"
BR2_TARGET_ARM_TRUSTED_FIRMWARE_IMAGES="bl31/bl31.elf"
BR2_TARGET_ROOTFS_EXT2=y
BR2_TARGET_ROOTFS_EXT2_4=y
BR2_TARGET_ROOTFS_EXT2_SIZE="500M"
BR2_TARGET_UBOOT=y
BR2_TARGET_UBOOT_BUILD_SYSTEM_KCONFIG=y

#BR2_TARGET_UBOOT_CUSTOM_VERSION=y
#BR2_TARGET_UBOOT_CUSTOM_VERSION_VALUE="2025.01"
BR2_TARGET_UBOOT_CUSTOM_TARBALL=y
BR2_TARGET_UBOOT_CUSTOM_TARBALL_LOCATION="https://gitlab.collabora.com/hardware-enablement/rockchip-3588/u-boot/-/archive/v2026.01/u-boot-v2026.01.tar.gz"
BR2_TARGET_UBOOT_BOARD_DEFCONFIG="rock5b-rk3588"
BR2_TARGET_UBOOT_CONFIG_FRAGMENT_FILES="board/radxa/rock5b/u-boot.fragment"
BR2_TARGET_UBOOT_NEEDS_PYLIBFDT=y
BR2_TARGET_UBOOT_NEEDS_PYELFTOOLS=y
BR2_TARGET_UBOOT_NEEDS_OPENSSL=y
BR2_TARGET_UBOOT_NEEDS_GNUTLS=y
BR2_TARGET_UBOOT_NEEDS_UTIL_LINUX=y
BR2_TARGET_UBOOT_NEEDS_ROCKCHIP_RKBIN=y
BR2_PACKAGE_HOST_DOSFSTOOLS=y
BR2_PACKAGE_HOST_DTC=y
BR2_PACKAGE_HOST_GENIMAGE=y
BR2_PACKAGE_HOST_MTOOLS=y

# WIRELESS FIRMWARE: Intel AX210
BR2_PACKAGE_LINUX_FIRMWARE_IWLWIFI_6E=y
BR2_PACKAGE_LINUX_FIRMWARE_IBT=y
BR2_PACKAGE_WIRELESS_TOOLS=y
BR2_PACKAGE_WPA_SUPPLICANT=y
BR2_PACKAGE_WPA_SUPPLICANT_CLI=y
# Can we add wlan network in etc overlay?

### HAOS
BR2_GLOBAL_PATCH_DIR="board/radxa/rock5b/patches $(BR2_EXTERNAL_HAOS_PATH)/patches"

#BR2_LINUX_KERNEL_CONFIG_FRAGMENT_FILES=$(BR2_EXTERNAL_HAOS_PATH)/kernel/v6.18.y/haos.config $(BR2_EXTERNAL_HAOS_PATH)/kernel/v6.18.y/docker.config $(BR2_EXTERNAL_HAOS_PATH)/kernel/v6.18.y/device-support.config $(BR2_EXTERNAL_HAOS_PATH)/kernel/v6.18.y/device-support-wireless.config $(BR2_EXTERNAL_HAOS_PATH)/board/nabucasa/green/kernel.config"
#BR2_LINUX_KERNEL_CUSTOM_CONFIG_FILE="$(BR2_EXTERNAL_HAOS_PATH)/kernel/v6.18.y/kernel-arm64-rockchip.config"

BR2_LINUX_KERNEL_LZ4=y
BR2_LINUX_KERNEL_NEEDS_HOST_LIBELF=y

### need to see what the HAOS custom config does...
#BR2_LINUX_KERNEL_USE_CUSTOM_CONFIG=y
#BR2_LINUX_KERNEL_USE_CUSTOM_CONFIG=y
BR2_PACKAGE_APPARMOR=y
BR2_PACKAGE_APPARMOR_PROFILES=y
BR2_PACKAGE_AUDIT=y
BR2_PACKAGE_BLUEZ5_UTILS=y
BR2_PACKAGE_BLUEZ5_UTILS_CLIENT=y
BR2_PACKAGE_BLUEZ5_UTILS_DEPRECATED=y
BR2_PACKAGE_BLUEZ5_UTILS_PLUGINS_AUDIO=y
BR2_PACKAGE_BLUEZ5_UTILS_PLUGINS_HID=y
BR2_PACKAGE_BLUEZ5_UTILS_TOOLS=y

### check what's in busybox.config
BR2_PACKAGE_BUSYBOX_CONFIG="$(BR2_EXTERNAL_HAOS_PATH)/busybox.config"
BR2_PACKAGE_BUSYBOX_INDIVIDUAL_BINARIES=y

BR2_PACKAGE_CA_CERTIFICATES=y
BR2_PACKAGE_CIFS_UTILS=y
BR2_PACKAGE_DBUS_BROKER=y
BR2_PACKAGE_DHCP=y
BR2_PACKAGE_DHCP_CLIENT=y
BR2_PACKAGE_DOCKER_CLI=y
BR2_PACKAGE_DOCKER_ENGINE=y
BR2_PACKAGE_DOSFSTOOLS=y
BR2_PACKAGE_DOSFSTOOLS_FSCK_FAT=y
BR2_PACKAGE_DROPBEAR=y
BR2_PACKAGE_DROPBEAR_DISABLE_REVERSEDNS=y
BR2_PACKAGE_E2FSPROGS_E2IMAGE=y
BR2_PACKAGE_GASKET=y
BR2_PACKAGE_GPTFDISK=y
BR2_PACKAGE_GPTFDISK_SGDISK=y
BR2_PACKAGE_HASSIO=y

### these need verifying...
BR2_PACKAGE_HASSIO_ARCH="aarch64"
BR2_PACKAGE_HASSIO_MACHINE="green"

BR2_PACKAGE_HOST_E2FSPROGS=y
BR2_PACKAGE_HOST_GPTFDISK=y

### not sure we need RAUC, don't have OTA updates :p and I think tempio is only used by RAUC
#BR2_PACKAGE_HOST_RAUC=y
#BR2_PACKAGE_HOST_TEMPIO=y

### do we need these?
#BR2_PACKAGE_HOST_UBOOT_TOOLS=y
#BR2_PACKAGE_HOST_UBOOT_TOOLS_BOOT_SCRIPT=y
## and this script?
#BR2_PACKAGE_HOST_UBOOT_TOOLS_BOOT_SCRIPT_SOURCE="$(BR2_EXTERNAL_HAOS_PATH)/board/nabucasa/green/uboot-boot.ush"

# BR2_PACKAGE_IFUPDOWN_SCRIPTS is not set
BR2_PACKAGE_IPROUTE2=y
BR2_PACKAGE_IPTABLES_NFTABLES=y
BR2_PACKAGE_IPTABLES_NFTABLES_DEFAULT=y
BR2_PACKAGE_JQ=y
BR2_PACKAGE_LIBCGROUP=y
BR2_PACKAGE_LIBCGROUP_TOOLS=y
BR2_PACKAGE_LIBCURL_CURL=y
BR2_PACKAGE_LIBDNET=y
# BR2_PACKAGE_LVM2_STANDARD_INSTALL is not set
BR2_PACKAGE_MTD=y
# BR2_PACKAGE_MTD_MTD_DEBUG is not set
# BR2_PACKAGE_MTD_NANDDUMP is not set
# BR2_PACKAGE_MTD_NANDTEST is not set
# BR2_PACKAGE_MTD_NANDWRITE is not set
BR2_PACKAGE_NETWORK_MANAGER=y
BR2_PACKAGE_NETWORK_MANAGER_CLI=y
BR2_PACKAGE_NFS_UTILS=y
# BR2_PACKAGE_NFS_UTILS_RPC_NFSD is not set
BR2_PACKAGE_OS_AGENT=y
BR2_PACKAGE_OS_AGENT_BOARD="Rock5B"
BR2_PACKAGE_PIGZ=y
BR2_PACKAGE_PROCPS_NG=y
#BR2_PACKAGE_RAUC=y
#BR2_PACKAGE_RAUC_DBUS=y
#BR2_PACKAGE_RAUC_NETWORK=y
#BR2_PACKAGE_ROCKCHIP_BLOBS=y
#BR2_PACKAGE_ROCKCHIP_BLOBS_ATF="bin/rk35/rk3568_bl31_v1.43.elf"
#BR2_PACKAGE_ROCKCHIP_BLOBS_TPL="bin/rk35/rk3566_ddr_1056MHz_v1.18.bin"
#BR2_PACKAGE_ROCKCHIP_BLOBS_VERSION="b4558da0860ca48bf1a571dd33ccba580b9abe23"
BR2_PACKAGE_RPCBIND=y
BR2_PACKAGE_RPI_RF_MOD=y
#BR2_PACKAGE_RTL8821CU=y
#BR2_PACKAGE_RTL88X2BU=y
BR2_PACKAGE_SYSTEMD_COREDUMP=y
# BR2_PACKAGE_SYSTEMD_HWDB is not set
BR2_PACKAGE_SYSTEMD_JOURNAL_REMOTE=y
BR2_PACKAGE_SYSTEMD_LOCALED=y
BR2_PACKAGE_SYSTEMD_LOGIND=y
# BR2_PACKAGE_SYSTEMD_NETWORKD is not set
BR2_PACKAGE_SYSTEMD_RANDOMSEED=y
BR2_PACKAGE_TINI=y
BR2_PACKAGE_UDISKS2=y
BR2_PACKAGE_USB_MODESWITCH_DATA=y
BR2_PACKAGE_UTIL_LINUX_LOGIN=y
BR2_PACKAGE_UTIL_LINUX_NOLOGIN=y
BR2_PACKAGE_UTIL_LINUX_PARTX=y
BR2_PACKAGE_UTIL_LINUX_ZRAMCTL=y
BR2_PACKAGE_V4L2LOOPBACK=y
BR2_PACKAGE_WIRELESS_REGDB=y
BR2_PACKAGE_WPA_SUPPLICANT_AP_SUPPORT=y
BR2_PACKAGE_WPA_SUPPLICANT_DBUS=y
BR2_PACKAGE_WPA_SUPPLICANT_DBUS_INTROSPECTION=y
BR2_PACKAGE_WPA_SUPPLICANT_WEXT=y
BR2_PACKAGE_WPA_SUPPLICANT_WPA3=y
BR2_ROOTFS_OVERLAY="$(BR2_EXTERNAL_HAOS_PATH)/rootfs-overlay"
#BR2_ROOTFS_POST_BUILD_SCRIPT="$(BR2_EXTERNAL_HAOS_PATH)/scripts/post-build.sh"
#BR2_ROOTFS_POST_IMAGE_SCRIPT="$(BR2_EXTERNAL_HAOS_PATH)/scripts/post-image.sh"
#BR2_ROOTFS_POST_SCRIPT_ARGS="$(BR2_EXTERNAL_HAOS_PATH)/board/nabucasa/green $(BR2_EXTERNAL_HAOS_PATH)/board/nabucasa/green/haos-hook.sh"
BR2_SSP_REGULAR=y
# BR2_TARGET_GENERIC_REMOUNT_ROOTFS_RW is not set
BR2_TARGET_LOCALTIME=""
BR2_TARGET_ROOTFS_EROFS=y
BR2_TARGET_ROOTFS_EROFS_DEDUPE=y
BR2_TARGET_ROOTFS_EROFS_FRAGMENTS=y
BR2_TARGET_ROOTFS_EROFS_LZ4HC_LEVEL=12
BR2_TARGET_ROOTFS_EROFS_PCLUSTERSIZE=262144
BR2_TARGET_ROOTFS_EROFS_ZTAILPACKING=y
# BR2_TARGET_ROOTFS_TAR is not set

### this probably isn't needed, we have rock5b u-boot from collabora
### just check that extra things aren't needed
#BR2_TARGET_UBOOT_CONFIG_FRAGMENT_FILES="$(BR2_EXTERNAL_HAOS_PATH)/bootloader/uboot.config $(BR2_EXTERNAL_HAOS_PATH)/board/nabucasa/green/uboot.config"
#BR2_TARGET_UBOOT_CUSTOM_VERSION=y
#BR2_TARGET_UBOOT_CUSTOM_VERSION_VALUE="2026.04"
#BR2_TARGET_UBOOT_FORMAT_CUSTOM=y
#BR2_TARGET_UBOOT_FORMAT_CUSTOM_NAME="u-boot-rockchip.bin"

BR2_TARGET_UBOOT_NEEDS_TPL=y
BR2_TOOLCHAIN_BUILDROOT_CXX=y
```
